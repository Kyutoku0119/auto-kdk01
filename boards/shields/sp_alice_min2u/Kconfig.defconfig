## boards/shields/sp_alice_min2u/Kconfig.defconfig
```kconfig
if SHIELD_SP_ALICE_MIN2U_LEFT

config ZMK_KEYBOARD_NAME
    default "sp_alice_min2u"

endif

if SHIELD_SP_ALICE_MIN2U_LEFT || SHIELD_SP_ALICE_MIN2U_RIGHT

config ZMK_SPLIT
    default y

endif
```

## boards/shields/sp_alice_min2u/Kconfig.shield
```kconfig
config SHIELD_SP_ALICE_MIN2U_LEFT
    def_bool $(shields_list_contains,sp_alice_min2u_left)
config SHIELD_SP_ALICE_MIN2U_RIGHT
    def_bool $(shields_list_contains,sp_alice_min2u_right)
```
